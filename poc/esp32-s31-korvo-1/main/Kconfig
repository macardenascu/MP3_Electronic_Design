## poc/esp32-s31-korvo-1/main/Kconfig
```kconfig
menu "MP3 Electronic Design PoC"

choice POC_MODE
    prompt "PoC application mode"
    default POC_MODE_STORAGE

config POC_MODE_STORAGE
    bool "SD storage diagnostic"

config POC_MODE_PCM
    bool "ES8389 PCM tone test"

endchoice

endmenu
```
